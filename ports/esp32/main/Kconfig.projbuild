## ports/esp32/main/Kconfig.projbuild
```kconfig
menu "Tern demo"

    choice TERN_BOARD
        prompt "Board"
        default TERN_BOARD_HELTEC_V3
        help
            The board the image is for: its pins and what it has fitted (main/boards.c). An
            image for one board does not run on another. boards/<name>.defaults sets this with
            the rest of what the board needs, such as its chip and console: build with
            ./build.sh <name>. Only the boards with the chip the build is for are offered.

        config TERN_BOARD_HELTEC_V3
            bool "Heltec WiFi LoRa 32 V3"
            depends on IDF_TARGET_ESP32S3
        config TERN_BOARD_HELTEC_V4
            bool "Heltec WiFi LoRa 32 V4 (V4.2 and V4.3)"
            depends on IDF_TARGET_ESP32S3
        config TERN_BOARD_HELTEC_WSL_V3
            bool "Heltec Wireless Stick Lite V3"
            depends on IDF_TARGET_ESP32S3
        config TERN_BOARD_HELTEC_TRACKER
            bool "Heltec Wireless Tracker (V1.0 and V1.1)"
            depends on IDF_TARGET_ESP32S3
        config TERN_BOARD_HELTEC_VME290
            bool "Heltec Vision Master E290"
            depends on IDF_TARGET_ESP32S3
        config TERN_BOARD_HELTEC_VME213
            bool "Heltec Vision Master E213"
            depends on IDF_TARGET_ESP32S3
        config TERN_BOARD_HELTEC_PAPER
            bool "Heltec Wireless Paper"
            depends on IDF_TARGET_ESP32S3
        config TERN_BOARD_HELTEC_V2
            bool "Heltec WiFi LoRa 32 V2"
            depends on IDF_TARGET_ESP32
        config TERN_BOARD_HELTEC_V21
            bool "Heltec WiFi LoRa 32 V2.1"
            depends on IDF_TARGET_ESP32
        config TERN_BOARD_LILYGO_T3_V161
            bool "LilyGo LoRa32 T3 V1.6.1 (SX1276)"
            depends on IDF_TARGET_ESP32
        config TERN_BOARD_LILYGO_TBEAM
            bool "LilyGo T-Beam V1.0 and V1.1 (AXP192, SX1276)"
            depends on IDF_TARGET_ESP32
        config TERN_BOARD_LILYGO_TBEAM12
            bool "LilyGo T-Beam V1.2 (AXP2101, SX1276)"
            depends on IDF_TARGET_ESP32
        config TERN_BOARD_LILYGO_T3S3
            bool "LilyGo T3-S3 V1.2 and V1.3 (SX1276)"
            depends on IDF_TARGET_ESP32S3
    endchoice

    config TERN_SCREEN_SH1106
        bool "The screen is an SH1106 (a 1.3-inch panel)"
        default n
        help
            For a board whose screen is fitted to its header rather than made with it, as the
            T-Beam's is: a 1.3-inch 128x64 panel is usually an SH1106 rather than the SSD1306 the
            0.96-inch one is. Without this its picture sits two columns off, or does not show.

    config TERN_BOARD_NAME
        string
        default "heltec-v3" if TERN_BOARD_HELTEC_V3
        default "heltec-v4" if TERN_BOARD_HELTEC_V4
        default "heltec-wsl-v3" if TERN_BOARD_HELTEC_WSL_V3
        default "heltec-tracker" if TERN_BOARD_HELTEC_TRACKER
        default "heltec-vme290" if TERN_BOARD_HELTEC_VME290
        default "heltec-vme213" if TERN_BOARD_HELTEC_VME213
        default "heltec-paper" if TERN_BOARD_HELTEC_PAPER
        default "heltec-v2" if TERN_BOARD_HELTEC_V2
        default "heltec-v21" if TERN_BOARD_HELTEC_V21
        default "lilygo-t3-v161" if TERN_BOARD_LILYGO_T3_V161
        default "lilygo-tbeam" if TERN_BOARD_LILYGO_TBEAM
        default "lilygo-tbeam12" if TERN_BOARD_LILYGO_TBEAM12
        default "lilygo-t3s3" if TERN_BOARD_LILYGO_T3S3

    rsource "../../node/Kconfig.tern"

endmenu
```

## ports/heltec-v3/main/Kconfig.projbuild
```kconfig
menu "Tern demo"

    config TERN_VERSION
        string "Version"
        default "0.0.0-dev"
        help
            What the board says it runs: on the console at start, and to a client over the
            companion link. A release sets it from its tag (release.sh).

    choice TERN_REGION
        prompt "Region"
        default TERN_REGION_US915
        help
            Where the board is used. It sets the frequency, bandwidth and spreading factor, and
            what the region's rules allow: see the profiles in the specification's draft/phy.md.
            A board is also built for one band, 863-928 MHz or 433/470-510 MHz for the Heltec
            V3; both of these regions need the first.

        config TERN_REGION_US915
            bool "US915: 921.25 MHz, 500 kHz, SF9 (United States, Canada)"
        config TERN_REGION_EU868
            bool "EU868: 869.475 MHz, 125 kHz, SF7, at most 10% of any hour"
    endchoice

    config TERN_TX_POWER_DBM
        int "Transmit power, in dBm (-9 to 22)"
        range -9 22
        default 2
        help
            What the radio puts into the antenna. The default is for a bench. The build refuses
            a power that, with the antenna's gain, is more than the region allows.

    config TERN_ANTENNA_DBI
        int "Antenna gain, in dBi"
        range -10 30
        default 3
        help
            The gain of the antenna fitted, which counts towards the power the region allows.
            The small antenna sold with the board is 2 to 3 dBi.

    config TERN_SCREEN_FLIP
        bool "Turn the screen upside down"
        default n
        help
            If the screen reads upside down on your board, or the board is mounted the other
            way up, this turns it round.

    config TERN_SCREEN_SLEEP_S
        int "Seconds before the screen sleeps (0: never)"
        range 0 65535
        default 60
        help
            How long the screen stays on after a press of PRG, a message heard or a pairing. A
            press while it is off only wakes it. 'screen sleep <seconds>' on the console changes
            it on a running board, and the board keeps the change.

    config TERN_SCREEN_BENCH
        bool "Show the bench screen's pages"
        default n
        help
            The developer's pages - routing ids, neighbours, routes, frame counts - after the
            user's. 'screen bench on|off' on the console changes it on a running board, and the
            board keeps the change.

    comment "For experiments. Changing these takes the board off its region's profile."

    config TERN_FREQ_HZ
        int "Frequency, in Hz (0: the region's)"
        range 0 960000000
        default 0

    config TERN_SF
        int "Spreading factor, 7 to 12 (0: the region's)"
        range 0 12
        default 0

    choice TERN_BW
        prompt "Bandwidth"
        default TERN_BW_REGION

        config TERN_BW_REGION
            bool "The region's"
        config TERN_BW_62
            bool "62.5 kHz"
        config TERN_BW_125
            bool "125 kHz"
        config TERN_BW_250
            bool "250 kHz"
        config TERN_BW_500
            bool "500 kHz"
    endchoice

    config TERN_BW_HZ
        int
        default 0 if TERN_BW_REGION
        default 62500 if TERN_BW_62
        default 125000 if TERN_BW_125
        default 250000 if TERN_BW_250
        default 500000 if TERN_BW_500

    config TERN_RELAY
        bool "Relay other nodes' frames"
        default y
        help
            A relay announces the routes it has and is routed through. A leaf announces only
            itself. Tern's routing draft (draft/routing.md) leaves the choice to the node's owner.

    config TERN_SYNC_WORD
        hex "Sync word, one-byte form"
        default 0x5E
        help
            Tern's is 0x5E (draft/phy.md). Meshtastic's is 0x2B, MeshCore's 0x12 and LoRaWAN's
            0x34; a board set to one of those hears that network's frames and can disturb it.

endmenu
```

## ports/node/Kconfig.tern
```kconfig
# The settings every Tern node is built with, which the node (node.c) reads as CONFIG_TERN_*. Each
# port's own Kconfig includes this inside its "Tern demo" menu, beside what is its own: the board.
# Indented as the menu it goes in.

    config TERN_VERSION
        string "Version"
        default "0.0.0-dev"
        help
            What the board says it runs: on the console at start, and to a client over the
            companion link. A release sets it from its tag (release.sh).

    choice TERN_REGION
        prompt "Region"
        default TERN_REGION_US915
        help
            Where the board is used. It sets the frequency, bandwidth and spreading factor, and
            what the region's rules allow: see the profiles in the specification's draft/phy.md.
            A board is also sold for one band, 863-928 MHz or 433/470-510 MHz; every one of
            these regions needs the first.

        config TERN_REGION_US915
            bool "US915: 921.25 MHz, 500 kHz, SF9 (United States, Canada)"
        config TERN_REGION_EU868
            bool "EU868: 869.475 MHz, 125 kHz, SF7, at most 10% of any hour"
        config TERN_REGION_AU915
            bool "AU915: 921.25 MHz, 500 kHz, SF9, 30 dBm EIRP (Australia)"
        config TERN_REGION_NZ915
            bool "NZ915: 921.25 MHz, 500 kHz, SF9, 36 dBm EIRP (New Zealand)"
        config TERN_REGION_CL915
            bool "CL915: 921.25 MHz, 500 kHz, SF9, 26 dBm EIRP (Chile)"
        config TERN_REGION_MY919
            bool "MY919: 920.25 MHz, 500 kHz, SF9, 26 dBm EIRP (Malaysia)"
        config TERN_REGION_TH920
            bool "TH920: 921.25 MHz, 500 kHz, SF9, 17 to 36 dBm EIRP, 10% of any hour (Thailand)"
        config TERN_REGION_RU868
            bool "RU868: 868.775 MHz, 125 kHz, SF7, 22 dBm EIRP, 10% of any hour (Russia)"
        config TERN_REGION_KZ863
            bool "KZ863: 864.375 MHz, 125 kHz, SF7, 13 dBm EIRP (Kazakhstan)"
    endchoice

    config TERN_TX_POWER_DBM
        int "Transmit power into the antenna, in dBm"
        range -9 30
        default 14 if TERN_REGION_TH920
        default 2
        help
            What the board puts into the antenna. The default is for a bench. A board refuses
            to start with a power it does not give (-9 to 22 dBm with an SX1262 alone, +4 to 28
            on the Heltec V4, whose amplifier adds to the radio's) or one that, with the
            antenna's gain, is more than the region allows, or less: TH920 requires 17 dBm
            radiated, which the default meets with an antenna of 3 dBi or more.

    config TERN_ANTENNA_DBI
        int "Antenna gain, in dBi"
        range -10 30
        default 3
        help
            The gain of the antenna fitted, which counts towards the power the region allows.
            The small antenna sold with the board is 2 to 3 dBi.

    config TERN_DESTINATIONS
        int "Destinations the board keeps routes for"
        range 32 4096
        default 128
        help
            How many nodes a relay can pass frames on toward, at 48 bytes of RAM each: the
            specification's RELAY_PLACES is 1024, and every port's builds set it
            (sdkconfig.defaults.esp32, sdkconfig.defaults.esp32s3, ports/nrf52/prj.conf). A leaf
            needs few: it hands a frame it has no route for to its nearest relay.

    config TERN_DESTINATIONS_HEAP
        bool "Take the destinations from the heap, as many as fit"
        default n
        help
            For a chip whose static RAM is full, as the classic ESP32's is: the table is taken
            from the heap at start, TERN_DESTINATIONS of them or half as many, down to 128, so
            that 64 KB of the heap is left for Bluetooth and the rest. 'status' on the console
            says how many it got.

    config TERN_SESSIONS
        int "Sessions the board holds: the nodes it can write to and hear from"
        range 8 32
        default 8
        help
            Each is about 1.4 KB of RAM and 290 bytes of flash. A board holding as many as
            this takes no new one until one is ended, so this is how many people its user can
            talk to at once. The ESP32-S3 and nRF52840 builds hold 16
            (sdkconfig.defaults.esp32s3, ports/nrf52/prj.conf); the classic ESP32's static RAM
            is full, and holds 8.

    config TERN_CONTACTS
        int "Contacts the board keeps"
        range 16 128
        default 16
        help
            Each is about 200 bytes of RAM, with what is shared with it, and 65 bytes of flash
            while it is kept: the record holds the places up to the last in use. The ESP32-S3
            and nRF52840 builds keep 32; more does not fit in an ESP32's 24 KB of storage beside
            the sessions and messages.

    config TERN_GROUPS
        int "Groups the board holds"
        range 4 16
        default 4
        help
            Each is about 1 KB of RAM, with its members' positions, and 190 bytes of flash
            with the writers it has heard. The ESP32-S3 and nRF52840 builds hold 8.

    config TERN_CARDS
        int "Presence cards the board holds from others: who is about"
        range 8 128
        default 32
        help
            80 bytes of RAM each, and no flash: the newest card from each address, the oldest
            let go of when there is no room. The ESP32-S3 and nRF52840 builds hold 64.

    config TERN_SCREEN_FLIP
        bool "Turn the screen upside down"
        default n
        help
            If the screen reads upside down on your board, or the board is mounted the other
            way up, this turns it round.

    config TERN_SCREEN_SLEEP_S
        int "Seconds before the screen sleeps (0: never)"
        range 0 65535
        default 60
        help
            How long the screen stays on after a press of the button, a message heard or a pairing. A
            press while it is off only wakes it. 'screen sleep <seconds>' on the console changes
            it on a running board, and the board keeps the change.

    config TERN_SCREEN_BENCH
        bool "Show the bench screen's pages"
        default n
        help
            The developer's pages - routing ids, neighbours, routes, frame counts - after the
            user's. 'screen bench on|off' on the console changes it on a running board, and the
            board keeps the change.

    config TERN_UNREAD_LED
        bool "Blink the LED while a message is unread"
        default y
        help
            A short blink every four seconds while a message has come and not been read, on the
            screen or on a client, for a board in sight whose screen is off.

    comment "For experiments. Changing these takes the board off its region's profile."

    config TERN_FREQ_HZ
        int "Frequency, in Hz (0: the region's)"
        range 0 960000000
        default 0

    config TERN_SF
        int "Spreading factor, 7 to 12 (0: the region's)"
        range 0 12
        default 0

    choice TERN_BW
        prompt "Bandwidth"
        default TERN_BW_REGION

        config TERN_BW_REGION
            bool "The region's"
        config TERN_BW_62
            bool "62.5 kHz"
        config TERN_BW_125
            bool "125 kHz"
        config TERN_BW_250
            bool "250 kHz"
        config TERN_BW_500
            bool "500 kHz"
    endchoice

    config TERN_BW_HZ
        int
        default 0 if TERN_BW_REGION
        default 62500 if TERN_BW_62
        default 125000 if TERN_BW_125
        default 250000 if TERN_BW_250
        default 500000 if TERN_BW_500

    config TERN_RELAY
        bool "Relay other nodes' frames"
        default y
        help
            A relay announces the routes it has and is routed through. A leaf announces only
            itself. Tern's routing draft (draft/routing.md) leaves the choice to the node's owner.

    config TERN_SYNC_WORD
        hex "Sync word, one-byte form"
        default 0x5E
        help
            Tern's is 0x5E (draft/phy.md). Meshtastic's is 0x2B, MeshCore's 0x12 and LoRaWAN's
            0x34; a board set to one of those hears that network's frames and can disturb it.
```
